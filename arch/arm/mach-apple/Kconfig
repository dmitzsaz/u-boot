## arch/arm/mach-apple/Kconfig
```kconfig
if ARCH_APPLE

config TEXT_BASE
	default 0x00000000

config SYS_SOC
	default "apple"

config SYS_VENDOR
	default "apple"

config SYS_BOARD
	string "Board name"
	default "mac"
	help
	  This option contains information about board name.
	  Based on this option board/<CONFIG_SYS_VENDOR>/<CONFIG_SYS_BOARD> will
	  be used.
	  Apple silicon based devices are expected to use the generic board name
	  "mac".

config SYS_MALLOC_LEN
	default 0x4000000

config SYS_MALLOC_F_LEN
	default 0x4000

config LNX_KRNL_IMG_TEXT_OFFSET_BASE
	default TEXT_BASE

config J704_SD
	bool "J704 built-in SD card reader"
	depends on DM_MMC && MMC_SDHCI && CMDLINE
	select MMC_SDHCI_IO_ACCESSORS
	help
	  Bring up APCIe port 2 and its Genesys GL9755 SD host on the J704
	  (MacBook Pro M5), with ADMA2 through port 2's owned DART stream. Adds
	  the j704sd command and the j704_sdboot environment, which boots the
	  card's /boot/extlinux/extlinux.conf.

endif
```
